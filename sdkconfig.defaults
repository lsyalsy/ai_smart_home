## sdkconfig.defaults
```kconfig
# 启用 BLE 与 NimBLE Host
CONFIG_BT_ENABLED=y
CONFIG_BT_NIMBLE_ENABLED=y
CONFIG_BT_BLUEDROID_ENABLED=n

# 启用 GATT Client 所需角色（NimBLE 默认已开启，显式声明更保险）
CONFIG_BT_NIMBLE_ROLE_CENTRAL=y
CONFIG_BT_NIMBLE_ROLE_OBSERVER=y
CONFIG_BT_NIMBLE_GATT_CLIENT=y

# WiFi
CONFIG_ESP_WIFI_ENABLED=y

# HTTP Server
CONFIG_HTTPD_MAX_REQ_HDR_LEN=1024

# cJSON
CONFIG_JSON_ENABLED=y

# HTTP Client (大模型 HTTPS 调用需要)
CONFIG_HTTP_CLIENT_ENABLE=y

# TLS (HTTPS 需要)
CONFIG_ESP_TLS_ENABLED=y
CONFIG_ESP_TLS_USE_CERT_BUNDLE=y
```
